## meta-aislim/conf/distro/aislim.conf
```bitbake
require conf/distro/include/tegrademo.inc

DISTRO = "aislim"
DISTRO_NAME = "AISlim AI Gateway Distro"
DISTRO_VERSION_BASE = "6.1"
DISTRO_VERSION = "${DISTRO_VERSION_BASE}+snapshot-${METADATA_REVISION}"
DISTRO_CODENAME = "master"
SDK_VENDOR = "-aislim"
TARGET_VENDOR = "-aislim"
MAINTAINER = "AISlim AI Gateway <ai-gateway@localhost>"

REQUIRED_TD_BBLAYERS_CONF_VERSION = "aislim-7"
LOCALCONF_VERSION = "2"

SDK_NAME = "${DISTRO}-${TCLIBC}-${SDKMACHINE}-${IMAGE_BASENAME}-${TUNE_PKGARCH}-${MACHINE}"
SDKPATHINSTALL = "/opt/${DISTRO}/${SDK_VERSION}"

INHERIT += "tegra-support-sanity"
ESDK_CLASS_INHERIT_DISABLE:append = " tegra-support-sanity"

BB_SIGNATURE_HANDLER ?= "OEEquivHash"
BB_HASHSERVE ??= "auto"

# ---- 资源极限留给 AI 的精简项（按需启用）----
# 去掉 PAM 鉴权框架（省内存/CPU）
#DISTRO_FEATURES:remove = "pam"
# 不用 docker 时去掉虚拟化特性（省大量包）
#DISTRO_FEATURES:remove = "virtualization"
```

## meta-aislim/conf/layer.conf
```bitbake
BBPATH =. "${LAYERDIR}:"
BBFILES += "${LAYERDIR}/recipes-*/*/*.bb ${LAYERDIR}/recipes-*/*/*.bbappend"

BBFILE_COLLECTIONS += "aislim"
BBFILE_PATTERN_aislim = "^${LAYERDIR}/"
BBFILE_PRIORITY_aislim = "60"

LAYERVERSION_aislim = "1"
LAYERDEPENDS_aislim = "core tegra tegrademo"
LAYERSERIES_COMPAT_aislim = "blacksail"
```

## meta-embedai/conf/distro/embedai.conf
```bitbake
require conf/distro/include/tegrademo.inc

DISTRO = "embedai"
DISTRO_NAME = "EmbedAI AI Gateway Distro"
DISTRO_VERSION_BASE = "6.1"
DISTRO_VERSION = "${DISTRO_VERSION_BASE}+snapshot-${METADATA_REVISION}"
DISTRO_CODENAME = "master"
SDK_VENDOR = "-embedai"
TARGET_VENDOR = "-embedai"
MAINTAINER = "EmbedAI AI Gateway <embedai@localhost>"

REQUIRED_TD_BBLAYERS_CONF_VERSION = "embedai-7"
LOCALCONF_VERSION = "2"

SDK_NAME = "${DISTRO}-${TCLIBC}-${SDKMACHINE}-${IMAGE_BASENAME}-${TUNE_PKGARCH}-${MACHINE}"
SDKPATHINSTALL = "/opt/${DISTRO}/${SDK_VERSION}"

INHERIT += "tegra-support-sanity"
ESDK_CLASS_INHERIT_DISABLE:append = " tegra-support-sanity"

BB_SIGNATURE_HANDLER ?= "OEEquivHash"
BB_HASHSERVE ??= "auto"

# ---- 资源极限留给 AI 的精简项（按需启用）----
# 去掉 PAM 鉴权框架（省内存/CPU）
#DISTRO_FEATURES:remove = "pam"
# 不用 docker 时去掉虚拟化特性（省大量包）
#DISTRO_FEATURES:remove = "virtualization"
```

## meta-embedai/conf/layer.conf
```bitbake
BBPATH =. "${LAYERDIR}:"
BBFILES += "${LAYERDIR}/recipes-*/*/*.bb ${LAYERDIR}/recipes-*/*/*.bbappend"

BBFILE_COLLECTIONS += "embedai"
BBFILE_PATTERN_embedai = "^${LAYERDIR}/"
BBFILE_PRIORITY_embedai = "60"

LAYERVERSION_embedai = "1"
LAYERDEPENDS_embedai = "core tegra tegrademo"
LAYERSERIES_COMPAT_embedai = "blacksail"
```
